## manifest/west.yml
```yaml
# Copyright (C) Intel Corporation, 2022
# SPDX-License-Identifier: MIT
#
# West manifest for multi-repo management
# See also: https://docs.zephyrproject.org/latest/guides/west/manifest.html

manifest:
  remotes:
    - name: sandbox
      url-base: https://github.com/intel-sandbox
    - name: github
      url-base: https://github.com
    - name: gitlab
      url-base: https://gitlab.com

  # put workspace repo at the top - this only works with `west init -l`
  self:
    path: .

  projects:

    ##
    # kAFL/Qemu/libxdc with some patches
    ##
    - name: kafl
      remote: github
      repo-path: IntelLabs/kAFL
      revision: kafl_tdx

    - name: qemu
      remote: github
      repo-path: IntelLabs/kafl.qemu
      revision: kafl_stable_tdx
      path: kafl/nyx/qemu
      groups:
        - qemu

    - name: libxdc
      remote: github
      repo-path: IntelLabs/kafl.libxdc
      revision: kafl_stable_tdx
      path: kafl/nyx/libxdc
      groups:
        - qemu
    ##
    # default capstone/radamsa
    ##
    - name: capstone
      remote: github
      repo-path: aquynh/capstone
      revision: v4
      path: kafl/nyx/capstone
      groups:
        - qemu

    - name: radamsa
      remote: gitlab
      repo-path: akihe/radamsa
      revision: develop
      path: kafl/radamsa
      groups:
        - radamsa

    ##
    # Target-specific repos
    ##

    # need htools component of Nyx 'packer'
    - name: nyx-packer
      remote: github
      repo-path: il-steffen/packer
      revision: kafl_stable
      path: kafl/nyx/packer
      groups:
        - nyx-packer

    # Linux TDX guest kernel
    - name: linux-guest
      remote: github
      repo-path: IntelLabs/kafl.linux
      revision: kafl/fuzz-5.15-3
      groups:
        - linux-guest

    # Linux TDX host emulation (+ kAFL)
    - name: linux-host
      remote: github
      repo-path: IntelLabs/kafl.linux
      revision: kafl/sdv-5.6-rc1
      groups:
        - tdx-host-sdv

    # EDK2 / TDVF for SDV + kAFL
    - name: tdvf
      remote: github
      repo-path: IntelLabs/kafl.edk2
      revision: TDVF_SDV
      submodules: true
      groups:
        - tdvf

    # Smatch static analyzer
    - name: smatch
      remote: github
      repo-path: error27/smatch
      revision: master
      path: smatch

  group-filter: [-tdx-host-sdv, -targets]
```
